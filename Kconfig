## Kconfig
```kconfig
# Custom component config
menu "esp-aws-iot-mqtt-config"
    config LIB_EXAMPLE
        int "Example variable"
        default 0
        help
            Just example, remove this.
endmenu
```

## example/main/Kconfig.projbuild
```kconfig
menu "Example Configuration"

    config EXAMPLE_WIFI_SSID
        string "WiFi SSID"
        default ""
        help
            SSID (network name) for the example to connect to.

    config EXAMPLE_WIFI_PASSWORD
        string "WiFi Password"
        default ""
        help
            WiFi password (WPA, WPA2 or WPA3) for the example to use.

    config EXAMPLE_AWS_IOT_MQTT_STORE
        bool "Store AWS IoT MQTT config"
        default n

    config EXAMPLE_AWS_IOT_MQTT_HOST
        string "AWS IoT MQTT host"
        depends on EXAMPLE_AWS_IOT_MQTT_STORE
        default ""
        help
            Your AWS hostname, can be found on the thing detail.

    config EXAMPLE_AWS_IOT_MQTT_PORT
        int "AWS IoT MQTT port"
        depends on EXAMPLE_AWS_IOT_MQTT_STORE
        default 8883
        help
            MQTT port, by default its 8883.

    choice EXAMPLE_AWS_IOT_MQTT_TRANSPORT
        prompt "AWS IoT MQTT transport type"
        default EXAMPLE_AWS_IOT_MQTT_TRANSPORT_SSL

        config EXAMPLE_AWS_IOT_MQTT_TRANSPORT_UNKNOWN
            bool "Unknown"
        config EXAMPLE_AWS_IOT_MQTT_TRANSPORT_TCP
            bool "MQTT over TCP, using scheme mqtt"
        config EXAMPLE_AWS_IOT_MQTT_TRANSPORT_SSL
            bool "MQTT over SSL, using scheme mqtts"
        config EXAMPLE_AWS_IOT_MQTT_TRANSPORT_WS
            bool "MQTT over Websocket, using scheme ws"
        config EXAMPLE_AWS_IOT_MQTT_TRANSPORT_WSS
            bool "MQTT over Websocket Secure, using scheme wss"
    endchoice

    config EXAMPLE_AWS_IOT_MQTT_TRANSPORT
        int
        default 1 if EXAMPLE_AWS_IOT_MQTT_TRANSPORT_TCP
        default 2 if EXAMPLE_AWS_IOT_MQTT_TRANSPORT_SSL
        default 3 if EXAMPLE_AWS_IOT_MQTT_TRANSPORT_WS
        default 4 if EXAMPLE_AWS_IOT_MQTT_TRANSPORT_WSS
        default 0

    config EXAMPLE_AWS_IOT_MQTT_CLIENT_ID
        string "AWS IoT MQTT client ID"
        depends on EXAMPLE_AWS_IOT_MQTT_STORE
        default ""
        help
            Usually found on the thing detail.
endmenu
```
